// Copyright 2024 Sean Luke
// (sean@cs.gmu.edu)
//
// Released under the Apache 2.0 License


/// LFO
///
/// LFO is a warpable LFO.  You have a choice of Tri, Sine, or Pulse, all with adjustable GAIN
/// and adjustable SHAPE. When the LFO completes its period, a TRIGGER is emitted on
/// digital out -- you could use this to sync things to the LFO for example.
///
/// You can adjust the SHAPE of the wave.  The shape of a Pulse wave is its Pulse Width,
/// hence PWM.  The shape of the Triangle wave goes from Sawtooth to Triangle to Ramp.
/// The shape of the Sine wave goes from being squished almost into a Sawtooth, to Cosine,
/// to being squished almost into a Ramp.
///
/// The LFO has adjustable RATE of course.  There are three ranges in which you can adjust
/// the rate: Short, Medium, and Long.  Within a range you can adjust the rate with the RATE
/// knob or CV.
///
/// Gain is provided on Audio IN.  By default, of course, that is 0.  So by default we disable
/// gain entirely.  If you'd like to control the LFO gain via CV on Audio In, then uncomment
/// (remove the // before) the following #define:

// #define GAIN

/// Pot 3 controls both the TYPE of the LFO wave (Tri, Sine, Pulse) and the RANGE (Short, Medium, Long).
/// Thus there are 9 options in total.  You will probably find MEDIUM to be the most useful range.
/// 
/// The LFO can also be RESET with a trigger.  
///
/// Note that the LFO can only reach about, oh, 4V due to limitations in GRAINS.
///
/// Looking for a RANDOM, NOISY, or SAMPLE AND HOLD LFO?  Try my GRAINS firmware STOCHASTIC.
///
/// Looking for multiple complex pulse wave LFOs?  Try my GRAINS firmware PULSES.


/// GRAINS BUG
/// 
/// There is a bug in GRAINS that affects Pots (Dials) 1 and 2.  If you set the 
/// switch to "Man", then the range of the Pot is correct.  But if you set the switch 
/// to "In 1" (or "In 2"), then the range of the Dial is maximum (1.0 probability for 
/// our purposes) at about the 2 o'clock position on the Dial.  Beyond that it stays at 1.0
///
///


/// CONFIGURATION 
///
/// IN 1            Shape / PWM CV
/// IN 2            Rate CV
/// IN 3            Reset
/// AUDIO IN (A)    Gain
/// AUDIO OUT       Output
/// DIGITAL OUT (D) Period Completion Trigger
///
/// POT 1           Shape / PWM
///					[If not using the CV, set switch to MAN, else set to IN2 and put pot at roughly 2'oclock]
///                 
///
/// POT 2          	Rate
///					[If not using the CV, set switch to MAN, else set to IN2 and put pot at roughly 2'oclock]
///                 
///
/// POT 3           Type (Short Saw/Tri/Ramp, Short Sine, Short Pulse, Medium Saw/Tri/Ramp, Medium Sine, Medium Pulse, Long Saw/Tri/Ramp, Long Sine, Long Pulse)
        


#define CONTROL_RATE 128

#include <MozziGuts.h>

#define CV_POT_IN1    A2    
#define CV_POT_IN2    A1   
#define CV_POT3       A0 
#define CV_IN3        A3
#define CV_AUDIO_IN   A4 
#define CV_AUDIO_OUT  9 
#define CV_GATE_OUT   8  
#define RANDOM_PIN    A5


uint8_t type;			// saw/tri/ramp, sine, pulse
uint8_t length;			// 0, 1, 2
uint8_t rate;			// 0...255
uint8_t gain;			// 0...127
uint16_t warp;			// 0...255
uint16_t position = 0;		// 0...1023

uint8_t count0;			// 0...255
uint8_t count1;			// 0...127
uint8_t count2;			// 0...127


// Generated in Mathematica with
// Tri[x_] := If[x < 0.5, x*4 - 1, 1 - (x - 0.5)*4]
// Table[Floor[Tri[x/1024] * 200] - 44, {x, 0, 1023}]

const PROGMEM int16_t TRIANGLE[1024] = 
{-244, -244, -243, -242, -241, -241, -240, -239, -238, -237, -237,
-236, -235, -234, -234, -233, -232, -231, -230, -230, -229, -228,
-227, -227, -226, -225, -224, -223, -223, -222, -221, -220, -219,
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-241, -241, -242, -243, -244};


// Generated in Mathematica with
// Table[Floor[-Cos[x / 1024 * 2 Pi]* 200] - 44 , {x, 0, 1023}]

const PROGMEM int16_t COSINE[1024] = 
{-244, -244, -244, -244, -244, -244, -244, -244, -244, -244, -244,
-244, -244, -244, -244, -244, -244, -243, -243, -243, -243, -243,
-243, -243, -242, -242, -242, -242, -242, -241, -241, -241, -241,
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-244, -244, -244, -244, -244, -244, -244};

const PROGMEM int16_t PULSE[1024] = 
{-244, -244, -244, -244, -244, -244, -244, -244, -244, -244, -244,
-244, -244, -244, -244, -244, -244, -244, -244, -244, -244, -244,
-244, -244, -244, -244, -244, -244, -244, -244, -244, -244, -244,
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156, 156};


const uint8_t rates[256] = 
{0, 0, 0, 0, 0, 0, 0, 0, 0, 0, 0, 0, 0, 0, 0, 0, 0, 0, 0, 0, 0, 1, 1,
1, 1, 1, 1, 1, 1, 1, 1, 1, 1, 1, 1, 1, 1, 1, 1, 1, 1, 1, 1, 1, 1, 1,
1, 1, 2, 2, 2, 2, 2, 2, 2, 2, 2, 2, 2, 2, 2, 2, 2, 2, 2, 2, 3, 3, 3,
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118, 120, 122, 125, 127};

float invwarp;
float invwarprem;


void setup() 
    {
    Serial.begin(250000);
    startMozzi();
    digitalWrite(CV_GATE_OUT, 0);		// so we match the digitalState
    }

// this is gonna be costly, it has to go to 32 bit
// And it has a division...
// Maybe we should go floating point and precompute the m2/2 and m2/(m-p).... 
inline uint16_t computeWarp(uint16_t val)
	{
	// warp goes 0...1023
	// val goes 0...1023
	
	// WARP FUNCTION IS:	X -> val 0...m, p -> pivot 0...m, m -> max
	// Output is 0...m
	
	// F[x_, m_, p_] := If[x < p, x/p * (m/2),
  	//						(x - p) / (m - p) * (m/2) + (m/2)]
	
	const uint16_t m = 1023;
	const uint32_t m2 = 511;
	uint16_t x = val;
	if (x < warp)
		{
		uint16_t w = (uint16_t)((x * m2) * invwarp);	// / p;
		return w;
		}
	else
		{
		uint16_t w = (uint16_t)( m2 + ((x - warp) * m2) * invwarprem); // / (m - p);
		return w;
		}
	}

inline void reset()
	{
	count0 = 0; 
	count1 = 0;
	count2 = 0;
	position = 0;
	}
	
inline uint8_t countdown()
	{
	if (length == 0)
		{
		return 128 - (rate >> 1);
		}
	else if (length == 1)
		{
		if (count0 > 0)
			{
			count0--;
			return 0;
			}
		else
			{
			count0 = rates[rate];
			return 1;
			}
		}
	else // if (length == 1)
		{
		if (count1 > 0)
			{
			count1--;
			return 0;
			}
		else if (count0 > 0)
			{
			count0--;
			count1 = 127;
			return 0;
			}
		else
			{
			count0 = rates[rate];
			count1 = 127;
			return 1;
			}
		}
	}

static uint8_t types[9] = { 0, 1, 2, 0, 1, 2, 0, 1, 2 };
static uint8_t lengths[9] = { 0, 0, 0, 1, 1, 1, 2, 2, 2 };
void updateControl() 
    {
	rate = mozziAnalogRead(CV_POT_IN2) >> 2;		// 256
	 warp = mozziAnalogRead(CV_POT_IN1);		// 1024
	 invwarp = 1.0 / warp;
	 invwarprem= 1.0 / (1023 - warp);
	 gain = mozziAnalogRead(CV_AUDIO_IN) >> 3;		// 128
	uint8_t pot3 = (mozziAnalogRead(CV_POT3) * 9) >> 10;
	type = types[pot3];
	uint8_t oldLength = length;
	length = lengths[pot3];

	if (length != oldLength || mozziAnalogRead(CV_IN3) > 512) reset();		// also reset if we're making a big change to speed
    }


#define _COSINE(warped) ((int16_t)pgm_read_word_near(&COSINE[warped]))
#define _TRIANGLE(warped) ((int16_t)pgm_read_word_near(&TRIANGLE[warped]))
#define _PULSE(warped) ((int16_t)pgm_read_word_near(&PULSE[warped]))

inline int16_t adjust(int16_t val)
	{
#ifdef GAIN
	return (val * gain) >> 7;
#else
	return val;
#endif
	}

uint8_t triggerCountdown;
int updateAudio()    
    {
    // drop trigger
	  if (triggerCountdown > 0)
    	{
    	if (triggerCountdown == 1)
    		{
			digitalWrite(CV_GATE_OUT, 0);
    		}
    	triggerCountdown--;
    	}

    // So this is gonna be slow.  May be an issue in terms of total LFO rate...
    
    uint8_t increment = countdown();
    position += increment;
    if (position >= 1024) position -= 1024;
    uint16_t warped = computeWarp(position);

	// set trigger if need be
	if (position == 0)
		{
		digitalWrite(CV_GATE_OUT, 1);
		triggerCountdown = 255;
		}
	
    if (type==0)		// Sine
    	{
    	return adjust(_COSINE(warped));
    	}
    else if (type == 1)			// Saw/Tri/Ramp
    	{
    	return adjust(_TRIANGLE(warped));
    	}
    else //if (type == 2)			// Square
    	{
    	return adjust(_PULSE(warped));
    	}
    }

void loop() 
    {
    audioHook();
    }
