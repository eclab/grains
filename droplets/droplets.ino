// Copyright 2023 Sean Luke
// (sean@cs.gmu.edu)
//
// Released under the Apache 2.0 License
//
// WARNING: Mozzi itself is released under a broken non-open-source license, namely the 
// Creative Commons Attribution-NonCommercial-ShareAlike 4.0 International License.
// This license is not compatible with the LGPL (used by the Arduino itself!) and is
// also viral, AND is non-commercial only.  What a mess.  I am pushing them to change 
// their license to something reasonable like Apache or GPL but in the meantime I don't 
// have much choice but to turn my head and ignore the broken license.  So I'm releasing
// under Apache for the time being.


/// Droplets
///
/// Droplets produces a tinkly chord of sine waves, like a wind chime.
/// Droplets is meant to run on the AE Modular GRAINS, but it could be adapted to any Arduino.
///
/// The tinkling is done by choosing a chord from POT 3.  You can then specify the degree of tinkle
/// (release) with POT 2.  Then every time you trigger Droplets it will issue one tinkle.  
///
/// SET GRAINS TO MOZZI MODE.  Sorry, no Grains mode.
///
/// You will need to install the Mozzi Library.  You can do this from the Library Manager
/// in your Arduino IDE.
///
///
/// CHOICE OF DROPLET CHORD
///
/// You current choices are (in order left to right): Maj, min, Maj7, min7, 7, dim7, Aug7, 5+Oct, 
/// Oct, Pentatonic, Whole Tone, and Chromatic.  Except for Whole Tone and Chromatic, most droplet 
/// chords range 3 or 4 octaves, with an emphasis on the fundamental.

///
///
/// RELEASE AND VOLUME
///
/// One potentiometer controls both the length of release of the individual tinkles and their volume.
/// Left to right, you have three broad regions: low volume, medium volume, and high volume.
/// Within a region, you have five levels of release from fast release to long release.  Why would
/// you want lower volume?  Because longer release tinkles, depending on the chord, will cause the
/// sine waves to overlap and add up to the point that they cause clipping.
///
///
/// NOISE
/// 
/// This program is pretty hissy.  Most of the problem is due to Mozzi I'm afraid.


/// ADJUSTING TUNING AND TRACKING
///
/// Grains's Inputs track 1.3V/octave, not 1V/octave: we'll need to scale them to track properly.  
/// To do this, you can adjust the Pitch CV Scaling on Pot 1.  This GRAINS program is set up to play 
/// the C two octaves below Middle C when it receives 0V.  You should be able to use Pot 1 to scale 
/// the pitch such that high Cs play in tune as well.  Once you have things tracking well, you can 
/// then use the Pitch Tune (Audio In) to tune 0V to some other note.  Note that as GRAINS resistors 
/// warm up, the scaling will change and you will need to adjust the tracking again, at least until 
/// they are fully warmed up.
///
/// By default the note corresponding to 0V is C0, three notes below middle C, that is MIDI note 24, 
/// or 32.7 Hz.  You can customize the tuning for this Grains program but only UP.  This can be done 
/// in two ways.  First, you can add pitch to the tuning with a CV value to Audio In.  Second, you 
/// can transpose the pitch up by changing the TRANSPOSE_OCTAVES and/or TRANSPOSE_SEMITONES #defines 
/// in the code to positive integers.
///
/// I recognize that Droplets will be hard to tune because of the tinkles.  By far the easiest to tune 
/// with is OCTAVES, which is the very last droplet option (turn the droplet knob fully to the right).


/// CONFIGURATION
///
/// IN 1            Pitch CV
/// IN 2            Release and Volume CV
/// IN 3            Trigger
/// AUDIO IN (A)    Pitch Tune
/// AUDIO OUT       Out
/// DIGITAL OUT (D) [Unused]
///
/// POT 1           Pitch Scaling	[Set the switch to In1]
///
/// POT 2           Release and Volume
///
/// POT 3           Choice of Droplets



PROGMEM const float frequencies[1024+512] = {
32.7, 32.81097, 32.922318, 33.034042, 33.146145, 33.25863, 33.37149, 33.48474, 33.59837, 33.71239, 33.826794, 33.94159, 34.056774, 34.172344, 34.28831, 34.40467, 
34.521423, 34.638577, 34.756123, 34.87407, 34.992416, 35.111168, 35.23032, 35.349876, 35.469837, 35.590206, 35.710987, 35.832172, 35.95377, 36.075783, 36.198208, 36.32105, 
36.444305, 36.56798, 36.692078, 36.816593, 36.941532, 37.066895, 37.192684, 37.3189, 37.445545, 37.572617, 37.700123, 37.82806, 37.956432, 38.08524, 38.214485, 38.34417, 
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5635.5815, 5654.706, 5673.8955, 5693.151, 5712.4707, 5731.856, 5751.3076, 5770.825, 5790.4087, 5810.0586, 5829.7754, 5849.5596, 5869.41, 5889.328, 5909.314, 5929.368, 
};


float rates[256] = {
// 0., 0.00981045, 0.0197171, 0.029721, 0.039823, 0.0500242, 0.0603254, 
// 0.0707276, 0.081232, 0.0918393, 0.102551, 0.113367, 0.12429, 0.13532, 
// 0.146458, 0.157705, 0.169063, 0.180532, 0.192113, 0.203808, 0.215618, 
// 0.227544, 0.239587, 0.251748, 0.264028, 0.276428, 0.288951, 0.301596, 
// 0.314365, 0.32726, 0.340281, 0.353429,
//0.366707, 0.380115, 0.393655, 
//0.407327, 0.421134, 0.435076, 0.449154, 0.463371, 0.477728, 0.492225, 
//0.506864, 0.521647, 0.536575, 0.55165, 0.566872, 0.582244, 0.597766, 
//0.613441, 0.62927, 0.645253, 0.661394, 0.677693, 0.694152, 0.710772, 
//0.727556, 0.744504, 0.761618, 0.778901, 0.796352, 0.813975, 0.831771, 
//0.849742,

0.0, 0.900981, 0.901972, 0.902972, 0.903982, 0.905002, 0.906033, 
0.907073, 0.908123, 0.909184, 0.910255, 0.911337, 0.912429, 0.913532, 
0.914646, 0.91577, 0.916906, 0.918053, 0.919211, 0.920381, 0.921562, 
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0.999985,
};


#define FREQUENCY(pitch) pgm_read_float_near(&frequencies[pitch])
#define CONTROL_RATE 64

#include <MozziGuts.h>
#include <Oscil.h>
#include <MetaOscil.h>
#include <tables/sin1024_int8.h>

Oscil<SIN1024_NUM_CELLS, AUDIO_RATE> sine1(SIN1024_DATA);
Oscil<SIN1024_NUM_CELLS, AUDIO_RATE> sine2(SIN1024_DATA);
Oscil<SIN1024_NUM_CELLS, AUDIO_RATE> sine3(SIN1024_DATA);
Oscil<SIN1024_NUM_CELLS, AUDIO_RATE> sine4(SIN1024_DATA);

int16_t nextSine = 0;

#define NUM_SINES 4 
Oscil<SIN1024_NUM_CELLS, AUDIO_RATE> sines[4] = 
    { 
    sine1, sine2, sine3, sine4, 
    };

int32_t gains[NUM_SINES];


#define CV_POT_IN1    A2    // Note In, Pitch Scaling
#define CV_POT_IN2    A1    // Release
#define CV_POT3       A0    // Choice of Droplets
#define CV_IN3        A3   	// Gain?
#define CV_AUDIO_IN   A4    // Pitch Tune
#define CV_AUDIO_OUT  9     // Out
#define CV_GATE_OUT   8     // Trigger
#define RANDOM_PIN    A5


void setup() 
    {
    // some reasonable initial defaults
	pinMode(CV_GATE_OUT, INPUT);
    initializeFrequency(CV_POT_IN1, CV_AUDIO_IN);
    randomSeed(RANDOM_PIN);
    startMozzi();
    }

#define MEDIAN_OF_THREE(a,b,c) (((a) <= (b)) ? (((b) <= (c)) ? (b) : (((a) < (c)) ? (c) : (a))) : (((a) <= (c)) ? (a) : (((b) < (c)) ? (c) : (b))))
uint16_t pitchCV;
uint16_t tuneCV;
uint16_t pA;
uint16_t pB;
void initializeFrequency(uint8_t pitch, uint8_t tune)
	{
	pitchCV = mozziAnalogRead(pitch);
	tuneCV = mozziAnalogRead(tune);
	}
	
#define TRANSPOSE_SEMITONES 0
#define TRANSPOSE_OCTAVES 0
#define LARGE_JUMP 32
#define SEMITONE 17
#define FREQ_COUNTER_MAX 4
uint8_t freqCounter = 0;
inline float getFrequency(uint8_t pitch, uint8_t tune)
	{
    tuneCV = (tuneCV * 15 + mozziAnalogRead(tune)) >> 4;
    uint16_t p = mozziAnalogRead(pitch);

    uint16_t diff = (p > pitchCV ? p - pitchCV : pitchCV - p);
    if (diff >= LARGE_JUMP)
    	{
    	pitchCV = p;		// jump right there
    	freqCounter = FREQ_COUNTER_MAX;
    	}
    else if (freqCounter > 0)
    	{
    	freqCounter--;
    	pitchCV = (pitchCV + p) >> 1;
    	pB = pA;
    	pA = pitchCV;
    	}
    else
    	{
    	uint16_t p1 = MEDIAN_OF_THREE(p, pA, pB);
    	pB = pA;
    	pA = p;
    	pitchCV = (pitchCV * 7 + p1) >> 3;
    	}
    uint16_t finalPitch = pitchCV + (tuneCV >> 1) + TRANSPOSE_SEMITONES * 17 + TRANSPOSE_OCTAVES * 205;
    return FREQUENCY(finalPitch > 1535 ? 1535 : finalPitch);
    }


// Relative frequency ratios for each semitone
PROGMEM const float semitoneFrequencyRatios[] = 
    {
	1.0,
	1.0594630943592953,
	1.122462048309373,
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	60.40795601162838,
	};


#define _C (0)
#define _Db (1)
#define _D (2)
#define _Eb (3)
#define _E (4)
#define _F (5)
#define _Gb (6)
#define _G (7)
#define _Ab (8)
#define _A (9)
#define _Bb (10)
#define _B (11)

#define _C1 (_C + 12)
#define _Db1 (_Db + 12)
#define _D1 (_D +  12)
#define _Eb1 (_Eb + 12)
#define _E1 (_E + 12)
#define _F1 (_F + 12)
#define _Gb1 (_Gb + 12)
#define _G1 (_G + 12)
#define _Ab1 (_Ab + 12)
#define _A1 (_A + 12)
#define _Bb1 (_Bb + 12)
#define _B1 (_B + 12)

#define _C2 (_C + 24)
#define _Db2 (_Db + 24)
#define _D2 (_D +  24)
#define _Eb2 (_Eb + 24)
#define _E2 (_E + 24)
#define _F2 (_F + 24)
#define _Gb2 (_Gb + 24)
#define _G2 (_G + 24)
#define _Ab2 (_Ab + 24)
#define _A2 (_A + 24)
#define _Bb2 (_Bb + 24)
#define _B2 (_B + 24)

#define _C3 (_C + 36)
#define _Db3 (_Db + 36)
#define _D3 (_D +  36)
#define _Eb3 (_Eb + 36)
#define _E3 (_E + 36)
#define _F3 (_F + 36)
#define _Gb3 (_Gb + 36)
#define _G3 (_G + 36)
#define _Ab3 (_Ab + 36)
#define _A3 (_A + 36)
#define _Bb3 (_Bb + 36)
#define _B3 (_B + 36)

#define _C4 (_C + 48)
#define _Db4 (_Db + 48)
#define _D4 (_D +  48)
#define _Eb4 (_Eb + 48)
#define _E4 (_E + 48)
#define _F4 (_F + 48)
#define _Gb4 (_Gb + 48)
#define _G4 (_G + 48)
#define _Ab4 (_Ab + 48)
#define _A4 (_A + 48)
#define _Bb4 (_Bb + 48)
#define _B4 (_B + 48)

#define _C5 (_C + 60)


#define NUM_CHORDS 12
#define NUM_NOTES 16

uint8_t chord = 0;
uint8_t lastPitch = 17;	// something bigger than notes
PROGMEM const float chords[NUM_CHORDS][NUM_NOTES] = 
	{
{_C, _C, _C, _E, _G, _C1, _E1, _G1, _C2, _E2, _G2, _C3, _E3, _G3, _C4},			// Maj
{_C, _C, _C, _Eb, _G, _C1, _Eb1, _G1, _C2, _Eb2, _G2, _C3, _Eb3, _G3, _C4},		// min
{_C, _C, _C, _E, _G, _B, _C1, _E1, _G1, _B1, _C2, _E2, _G2, _B2, _C3 },			// Maj7
{_C, _C, _C, _Eb, _G, _Bb, _C1, _Eb1, _G1, _Bb1, _C2, _Eb2, _G2, _Bb2, _C3 },	// min7
{_C, _C, _C, _E, _G, _Bb, _C1, _Eb, _G1, _Bb1, _C2, _Eb, _G2, _Bb2, _C3 },		// 7
{_C, _C, _C, _Eb, _Gb, _A, _C1, _Eb, _Gb1, _A1, _C2, _Eb, _Gb2, _A, _C3 },		// dim7
{_C, _C, _C, _E, _Ab, _C1, _E, _Ab1, _C2, _E, _Ab2, _C3, _E, _Ab2, _C4 },		// Aug7
{_C, _D, _G, _A, _C1, _D2, _E2, _G2, _A2, _C3, _D3, _E3, _G3, _A3, _C4 },		// Pentatonic
{_C, _C, _C, _D, _E, _Gb, _Ab, _Bb, _C1, _D1, _E1, _Gb1, _Ab1, _Bb1, _C2},		// Whole Tone
{_C, _C, _C, _Db, _D, _Eb, _E, _F, _Gb, _G, _Ab, _A, _Bb, _B, _C2 },			// Chromatic
{_C, _G, _C1, _G2, _C2, _G2, _C3, _G3, _C4, _G, _C1, _G2, _C2, _G3, _C3 },		// 5 + Oct
{_C, _C, _C, _C1, _C2, _C3, _C4, _C1, _C2, _C3, _C4, _C1, _C2, _C3, _C4 },		// Oct
	};
	
#define NYQUIST 16384
float baseFrequency;
uint8_t overallGain;

#define SEMITONE_FREQUENCY_RATIOS(pitch) pgm_read_float_near(&semitoneFrequencyRatios[pitch])

#define CHORDS(c,n) pgm_read_float_near(&chords[c][n])



uint8_t release;
uint8_t triggered = false;
uint8_t odd = 0;

void updateControl() 
    {
	if (odd)
	{
	baseFrequency = getFrequency(CV_POT_IN1, CV_AUDIO_IN);

	// Not sure we should bother filtering these, probably not
	chord = (mozziAnalogRead(CV_POT3) * NUM_CHORDS) >> 10;
	
	uint8_t releaseAndCut = (mozziAnalogRead(CV_POT_IN2) * 15) >> 10;
	if (releaseAndCut < 5)
		{
		release = releaseAndCut;
		overallGain = 2;
		}
	else if (releaseAndCut < 10)
		{
		release = releaseAndCut - 5;
		overallGain = 3;
		}
	else
		{
		release = releaseAndCut - 10;
		overallGain = 4;
		}
	}
	
	// Check for a trigger
	uint8_t tr = digitalRead(CV_GATE_OUT);
	if (!triggered && tr)
		{
		trigger();
		triggered = 1;
		}
	else if (!tr)
		{
		triggered = 0;
		}
	odd = !odd;
    }

uint16_t countIn[NUM_SINES];
int16_t _gains[4];
uint8_t _max[4];
uint8_t _counters[4];
uint8_t releases[5] = { 16, 32, 64, 128, 255 };
void trigger()
	{
	// Determine the note, hence the frequency
	uint8_t note;
	float frequency = baseFrequency;		// a reasonable default
	uint8_t pitch;
	for(uint8_t i = 0; i < 16; i++)
		{
		while(true)
			{
			note = random(NUM_NOTES);
			pitch = CHORDS(chord, note); // chords[chord][note];
			if (pitch != lastPitch) break;
			}
		float f = SEMITONE_FREQUENCY_RATIOS(pitch);
		if (baseFrequency * f < NYQUIST) { frequency = f; break; }
		}
	lastPitch = pitch;
		
	// Set things up
	// If we're at zero volume, let's reset.  I'm worried that if we reset at a larger volume we'll click.
	countIn[nextSine] = 7;	// because we increase by 8 and want to end at 255
	_gains[nextSine] = 127;
	sines[nextSine].setPhase(0);
	sines[nextSine].setFreq(frequency * baseFrequency);
	_counters[nextSine] = _max[nextSine] = releases[release];
	nextSine++;
	if (nextSine >= NUM_SINES) 
		nextSine = 0;
	}


inline int32_t attenuate(uint8_t i, int8_t in)
	{
	if (countIn[i] < 256 - 8) countIn[i]+=8;
	if (_counters[i] == 0)
		{
		if (_gains[i] > 0) _gains[i]--;
		_counters[i] = _max[i];
		}
	else
		{
		_counters[i]--;
		}
	return (in * _gains[i] * (int32_t)countIn[i]) >> 8;
	}
	

// Gain should go 1...4
int updateAudio()    
    {
    int16_t a = (
    	+ attenuate(0, (sines[0].next()))
    	+ attenuate(1, (sines[1].next()))
    	+ attenuate(2, (sines[2].next()))
    	+ attenuate(3, (sines[3].next())) * overallGain) >> 1;

    return MonoOutput::from16Bit(a);
    }


void loop() 
    {
    audioHook();
    }
